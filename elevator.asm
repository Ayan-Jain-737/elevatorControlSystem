; 8051 16-Floor Elevator Control System
; Target: P89V51RD2, Crystal: 11.0592 MHz

$NOMOD51
$INCLUDE (REG51.INC)

CURRENT_FLOOR   EQU 30H
DIRECTION       EQU 31H
STATE           EQU 32H
TICK_COUNT      EQU 33H
DOOR_TIMER      EQU 34H
QUEUE_HEAD      EQU 35H
QUEUE_TAIL      EQU 36H
QUEUE_COUNT     EQU 37H

TARGET_ARRAY    EQU 40H ; 40H to 4FH used for 16 floors (1 byte per floor, 0=None, 1=Req)
QUEUE_ARRAY     EQU 60H ; 60H to 6FH used for FIFO queue

STATE_CHANGED   BIT 20H.0
EMERGENCY_FLAG  BIT 20H.1

ST_IDLE         EQU 0
ST_MOVING       EQU 1
ST_DOOR_OPEN    EQU 2
ST_EMERGENCY    EQU 3

DIR_IDLE        EQU 0
DIR_UP          EQU 1
DIR_DOWN        EQU 2

MOTOR_UP        BIT P2.0
MOTOR_DOWN      BIT P2.1
DOOR_CTRL       BIT P2.2

ORG 0000H
    LJMP INIT

ORG 0003H
    LJMP EXT0_ISR

ORG 000BH
    LJMP T0_ISR

ORG 0023H
    LJMP UART_ISR

ORG 0050H
INIT:
    MOV SP, #80H

    MOV CURRENT_FLOOR, #0
    MOV DIRECTION, #DIR_IDLE
    MOV STATE, #ST_IDLE
    MOV TICK_COUNT, #0
    MOV DOOR_TIMER, #0
    MOV QUEUE_HEAD, #0
    MOV QUEUE_TAIL, #0
    MOV QUEUE_COUNT, #0
    CLR STATE_CHANGED
    CLR EMERGENCY_FLAG

    ; Clear Target Array (from 40H to 4FH)
    MOV R0, #40H
    MOV R1, #16
CLR_ARR:
    MOV @R0, #0
    INC R0
    DJNZ R1, CLR_ARR

    CLR MOTOR_UP
    CLR MOTOR_DOWN
    CLR DOOR_CTRL

    ; Setup UART (Timer 1 Mode 2, 9600 baud @ 11.0592 MHz)
    MOV TMOD, #21H
    MOV TH1, #0FDH
    MOV SCON, #50H
    SETB TR1

    ; Setup Timer 0 (50ms interrupt)
    MOV TH0, #4CH
    MOV TL0, #00H
    SETB TR0

    SETB IT0            ; Trigger INT0 on falling edge
    SETB EX0
    SETB ET0
    SETB ES
    SETB EA

    AJMP MAIN_LOOP


; External Interrupt 0 (Emergency)
EXT0_ISR:
    SETB EMERGENCY_FLAG
    SETB STATE_CHANGED
    RETI


; Timer 0 Interrupt (50ms Tick)
T0_ISR:
    MOV TH0, #4CH
    MOV TL0, #00H
    
    MOV A, STATE
    CJNE A, #ST_MOVING, T0_CHK_DOOR
    INC TICK_COUNT
    SJMP T0_END

T0_CHK_DOOR:
    CJNE A, #ST_DOOR_OPEN, T0_END
    INC DOOR_TIMER

T0_END:
    RETI


; UART Interrupt
UART_ISR:
    JNB RI, UART_ISR_END
    CLR RI
    MOV A, SBUF
    
    CJNE A, #'E', CHK_O
    SETB EMERGENCY_FLAG
    SETB STATE_CHANGED
    SJMP UART_ISR_END

CHK_O:
    CJNE A, #'O', CHK_X
    ; Door Open Override
    MOV R2, STATE
    CJNE R2, #ST_DOOR_OPEN, CHK_X_CONT
    MOV DOOR_TIMER, #0
    SJMP UART_ISR_END

CHK_X_CONT:
    SJMP UART_ISR_END

CHK_X:
    CJNE A, #'X', CHK_CALL
    MOV R2, STATE
    CJNE R2, #ST_DOOR_OPEN, UART_ISR_END
    MOV DOOR_TIMER, #40 ; Force timeout
    SJMP UART_ISR_END

CHK_CALL:
    ; Protocol: floor is 'A' (0) to 'P' (15)
    CLR C
    SUBB A, #'A'
    JC UART_ISR_END ; Less than 'A'
    MOV R2, A ; R2 holds 0 to 15 (which is floor)
    CLR C
    SUBB A, #16
    JNC UART_ISR_END ; >= 16

    ; Valid floor check
    MOV A, #TARGET_ARRAY
    ADD A, R2
    MOV R0, A
    MOV A, @R0
    JNZ UART_ISR_END ; If already 1, don't queue duplicates
    
    MOV @R0, #1
    
    ; Add R2 to queue
    MOV A, QUEUE_COUNT
    CJNE A, #16, ADD_Q
    SJMP UART_STATE_CHG ; queue full safeguard
ADD_Q:
    MOV A, #QUEUE_ARRAY
    ADD A, QUEUE_TAIL
    MOV R0, A
    MOV @R0, R2
    INC QUEUE_COUNT
    INC QUEUE_TAIL
    MOV A, QUEUE_TAIL
    CJNE A, #16, UART_STATE_CHG
    MOV QUEUE_TAIL, #0

UART_STATE_CHG:
    SETB STATE_CHANGED

UART_ISR_END:
    RETI


MAIN_LOOP:
    JNB STATE_CHANGED, MAIN_FSM
    CLR STATE_CHANGED
    ACALL SEND_STATE

MAIN_FSM:
    MOV A, STATE
    CJNE A, #ST_IDLE, CHK_FSM_MOVING
    ACALL HANDLE_IDLE
    SJMP MAIN_LOOP

CHK_FSM_MOVING:
    CJNE A, #ST_MOVING, CHK_FSM_DOOR
    ACALL HANDLE_MOVING
    SJMP MAIN_LOOP

CHK_FSM_DOOR:
    CJNE A, #ST_DOOR_OPEN, MAIN_LOOP_END
    ACALL HANDLE_DOOR
MAIN_LOOP_END:
    SJMP MAIN_LOOP


HANDLE_IDLE:
    JNB EMERGENCY_FLAG, IDLE_NORM
    CLR EMERGENCY_FLAG
    MOV STATE, #ST_DOOR_OPEN
    MOV DOOR_TIMER, #0
    SETB DOOR_CTRL
    SETB STATE_CHANGED
    ACALL CLEAR_CURRENT_REQUEST
    RET
IDLE_NORM:
    ACALL HAS_ANY_REQUESTS
    JNC IDLE_RET

    ACALL DECIDE_DIRECTION
    MOV A, DIRECTION
    CJNE A, #DIR_IDLE, START_MOVING
IDLE_RET:
    RET

START_MOVING:
    MOV STATE, #ST_MOVING
    MOV TICK_COUNT, #0
    SETB STATE_CHANGED
    MOV A, DIRECTION
    CJNE A, #DIR_UP, MOTOR_D
    SETB MOTOR_UP
    CLR MOTOR_DOWN
    RET
MOTOR_D:
    CLR MOTOR_UP
    SETB MOTOR_DOWN
    RET


HANDLE_MOVING:
    MOV A, TICK_COUNT
    CJNE A, #20, MOVING_RET   ; wait ~1s per floor
    MOV TICK_COUNT, #0

    MOV A, DIRECTION
    CJNE A, #DIR_UP, MOV_DOWN
    INC CURRENT_FLOOR
    SJMP MOV_CHECK
MOV_DOWN:
    DEC CURRENT_FLOOR

MOV_CHECK:
    SETB STATE_CHANGED

    JB EMERGENCY_FLAG, ARRIVED_AT_FLOOR
    ACALL IS_REQUEST_AT_CURRENT
    JNC CONTINUE_MOVING
    
ARRIVED_AT_FLOOR:
    CLR EMERGENCY_FLAG
    CLR MOTOR_UP
    CLR MOTOR_DOWN
    MOV STATE, #ST_DOOR_OPEN
    MOV DOOR_TIMER, #0
    SETB DOOR_CTRL
    SETB STATE_CHANGED
    
    ACALL CLEAR_CURRENT_REQUEST
    RET

CONTINUE_MOVING:
    ACALL DECIDE_DIRECTION
    MOV A, DIRECTION
    CJNE A, #DIR_IDLE, MOVING_RET
    CLR MOTOR_UP
    CLR MOTOR_DOWN
    MOV STATE, #ST_IDLE
    SETB STATE_CHANGED
MOVING_RET:
    RET


HANDLE_DOOR:
    MOV A, DOOR_TIMER
    CLR C
    SUBB A, #40
    JC DOOR_RET     ; wait ~2s to keep door open
    
    CLR DOOR_CTRL
    MOV STATE, #ST_IDLE
    SETB STATE_CHANGED
DOOR_RET:
    RET


; Check if any request in array (returns C=1 if yes, C=0 if no)
HAS_ANY_REQUESTS:
    MOV R0, #TARGET_ARRAY
    MOV R3, #16
CHK_ANY_LOOP:
    MOV A, @R0
    JNZ ANY_FOUND
    INC R0
    DJNZ R3, CHK_ANY_LOOP
    CLR C
    RET
ANY_FOUND:
    SETB C
    RET


; Check if TARGET_ARRAY for CURRENT_FLOOR is 1 (returns C=1)
IS_REQUEST_AT_CURRENT:
    MOV A, #TARGET_ARRAY
    ADD A, CURRENT_FLOOR
    MOV R0, A
    MOV A, @R0
    JNZ REQ_CUR_FOUND
    CLR C
    RET
REQ_CUR_FOUND:
    SETB C
    RET


; Clear the array element for CURRENT_FLOOR
CLEAR_CURRENT_REQUEST:
    MOV A, #TARGET_ARRAY
    ADD A, CURRENT_FLOOR
    MOV R0, A
    MOV @R0, #0
    RET


; Evaluates Array to update DIRECTION
DECIDE_DIRECTION:
    ACALL HAS_ANY_REQUESTS
    JNC NO_DIR
    
    MOV A, DIRECTION
    CJNE A, #DIR_UP, SCAN_DOWN

SCAN_UP:
    ACALL HAS_UPPER_REQUESTS
    JC KEEP_UP
    ACALL HAS_LOWER_REQUESTS
    JC SWITCH_DOWN
    SJMP NO_DIR

SCAN_DOWN:
    CJNE A, #DIR_DOWN, SCAN_IDLE
    ACALL HAS_LOWER_REQUESTS
    JC KEEP_DOWN
    ACALL HAS_UPPER_REQUESTS
    JC SWITCH_UP
    SJMP NO_DIR

SCAN_IDLE:
    ACALL PEEK_QUEUE
    JC NO_DIR
    ; R2 holds valid oldest request
    MOV A, R2
    CJNE A, CURRENT_FLOOR, CHECK_Q_DIR
    SJMP NO_DIR
CHECK_Q_DIR:
    JC Q_DOWN   ; if R2 < CURRENT_FLOOR, C=1
    SJMP Q_UP   ; else C=0 -> R2 > CURRENT_FLOOR
Q_DOWN:
    MOV DIRECTION, #DIR_DOWN
    RET
Q_UP:
    MOV DIRECTION, #DIR_UP
    RET
    
KEEP_UP:    MOV DIRECTION, #DIR_UP    | RET
SWITCH_DOWN:MOV DIRECTION, #DIR_DOWN  | RET
KEEP_DOWN:  MOV DIRECTION, #DIR_DOWN  | RET
SWITCH_UP:  MOV DIRECTION, #DIR_UP    | RET
NO_DIR:     MOV DIRECTION, #DIR_IDLE  | RET


PEEK_QUEUE:
    MOV A, QUEUE_COUNT
    JZ Q_EMPTY
    MOV A, #QUEUE_ARRAY
    ADD A, QUEUE_HEAD
    MOV R0, A
    MOV A, @R0
    MOV R2, A ; oldest request
    
    ; Check TARGET_ARRAY directly
    MOV A, #TARGET_ARRAY
    ADD A, R2
    MOV R0, A
    MOV A, @R0
    JNZ Q_VALID
    
    ; Popping stale (serviced) element
    INC QUEUE_HEAD
    MOV A, QUEUE_HEAD
    CJNE A, #16, DEQ_1
    MOV QUEUE_HEAD, #0
DEQ_1:
    DEC QUEUE_COUNT
    SJMP PEEK_QUEUE
Q_EMPTY:
    SETB C
    RET
Q_VALID:
    CLR C
    RET


HAS_UPPER_REQUESTS:
    MOV A, CURRENT_FLOOR
    CJNE A, #15, CAN_CHECK_UP
    CLR C
    RET
CAN_CHECK_UP:
    MOV R0, #TARGET_ARRAY
    ADD A, R0
    INC A            
    MOV R0, A 
    MOV A, #15
    CLR C
    SUBB A, CURRENT_FLOOR
    MOV R3, A 
CHK_UP_LOOP:
    MOV A, @R0
    JNZ UP_FOUND
    INC R0
    DJNZ R3, CHK_UP_LOOP
    CLR C
    RET
UP_FOUND:
    SETB C
    RET


HAS_LOWER_REQUESTS:
    MOV A, CURRENT_FLOOR
    CJNE A, #0, CAN_CHECK_DN
    CLR C
    RET
CAN_CHECK_DN:
    MOV R0, #TARGET_ARRAY
    MOV A, CURRENT_FLOOR
    MOV R3, A 
CHK_DN_LOOP:
    MOV A, @R0
    JNZ DN_FOUND
    INC R0
    DJNZ R3, CHK_DN_LOOP
    CLR C
    RET
DN_FOUND:
    SETB C
    RET


; Send elevator state over UART
SEND_STATE:
    MOV A, #'F' | ACALL SEND_CHAR
    MOV A, #':' | ACALL SEND_CHAR
    
    MOV A, CURRENT_FLOOR
    MOV B, #10
    DIV AB
    JZ SEND_UNITS 
    ADD A, #'0'
    ACALL SEND_CHAR
SEND_UNITS:
    MOV A, B
    ADD A, #'0'
    ACALL SEND_CHAR

    MOV A, #'|' | ACALL SEND_CHAR
    
    MOV A, #'D' | ACALL SEND_CHAR
    MOV A, #':' | ACALL SEND_CHAR
    MOV A, DIRECTION
    CJNE A, #DIR_UP, CHK_DIR_DN
    MOV A, #'U' | SJMP SND_DIR
CHK_DIR_DN:
    CJNE A, #DIR_DOWN, CHK_DIR_IDLE
    MOV A, #'D' | SJMP SND_DIR
CHK_DIR_IDLE:
    MOV A, #'I'
SND_DIR:
    ACALL SEND_CHAR
    MOV A, #'|' | ACALL SEND_CHAR
    
    MOV A, #'D' | ACALL SEND_CHAR
    MOV A, #'R' | ACALL SEND_CHAR
    MOV A, #':' | ACALL SEND_CHAR
    MOV A, STATE
    CJNE A, #ST_DOOR_OPEN, SND_DR_0
    MOV A, #'1' | SJMP SND_DR_DONE
SND_DR_0:
    MOV A, #'0'
SND_DR_DONE:
    ACALL SEND_CHAR
    MOV A, #'|' | ACALL SEND_CHAR
    
    MOV A, #'E' | ACALL SEND_CHAR
    MOV A, #':' | ACALL SEND_CHAR
    JNB EMERGENCY_FLAG, SND_E_0
    MOV A, #'1' | SJMP SND_E_DONE
SND_E_0:
    MOV A, #'0'
SND_E_DONE:
    ACALL SEND_CHAR
    MOV A, #10
    ACALL SEND_CHAR
    RET

SEND_CHAR:
    CLR ES
    MOV SBUF, A
WAIT_TI:
    JNB TI, WAIT_TI
    CLR TI
    SETB ES
    RET

    END
